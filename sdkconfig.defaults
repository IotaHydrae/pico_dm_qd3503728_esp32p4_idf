## wireless/p4_wifi_ota/sdkconfig.defaults
```kconfig
# Default configuration for Host Slave OTA Simple Example

# Flash size configuration
CONFIG_ESPTOOLPY_FLASHSIZE_8MB=y
CONFIG_ESPTOOLPY_FLASHSIZE="8MB"

# Force enable ESP-Hosted component
CONFIG_ESP_WIFI_REMOTE_ENABLED=y
CONFIG_ESP_HOSTED_ENABLED=y

# FreeRTOS configuration
CONFIG_FREERTOS_HZ=1000

# Partition table
CONFIG_PARTITION_TABLE_CUSTOM=y
CONFIG_PARTITION_TABLE_CUSTOM_FILENAME="partitions.csv"
CONFIG_PARTITION_TABLE_FILENAME="partitions.csv"

# ---- 本板与 hosted 的必需项（从 p4_wifi_probe 那轮实测继承）----
CONFIG_ESP32P4_SELECTS_REV_LESS_V3=y
CONFIG_ESP32P4_REV_MIN_100=y
CONFIG_ESPTOOLPY_FLASHSIZE_16MB=y
CONFIG_ESPTOOLPY_FLASHSIZE="16MB"
CONFIG_SPIRAM=y
CONFIG_SPIRAM_SPEED_200M=y
CONFIG_SPIRAM_XIP_FROM_PSRAM=y
CONFIG_CACHE_L2_CACHE_256KB=y
CONFIG_CACHE_L2_CACHE_LINE_128B=y
CONFIG_ESP_HOSTED_MEMPOOL_PREFER_SPIRAM=y
CONFIG_ESP_HOSTED_DFLT_TASK_FROM_SPIRAM=y
CONFIG_ESP_WIFI_SOFTAP_SUPPORT=n
CONFIG_SLAVE_IDF_TARGET_ESP32C6=y

# 用 partition 法：从机固件放在本机的 slave_fw 分区里（不联网）
CONFIG_OTA_METHOD_PARTITION=y
CONFIG_OTA_PARTITION_LABEL="slave_fw"
# 从机可能不支持版本查询（它报 0.0.0），别让它挡在 OTA 之前
CONFIG_OTA_VERSION_CHECK_HOST_SLAVE=n
```

## wireless/p4_wifi_probe/main/Kconfig.projbuild
```kconfig
menu "P4 wifi probe"

    config PROBE_WIFI_SSID
        string "WiFi SSID"
        default "myssid"

    config PROBE_WIFI_PASSWORD
        string "WiFi password"
        default ""

    config PROBE_WIFI_IP_TIMEOUT_S
        int "Seconds to wait for an IP before giving up"
        default 30

endmenu
```

## wireless/p4_wireless_display/main/Kconfig.projbuild
```kconfig
menu "Wireless display demo"

    config WDD_WIFI_SSID
        string "WiFi SSID"
        default "myssid"

    config WDD_WIFI_PASSWORD
        string "WiFi password"
        default ""

    config WDD_WIFI_IP_TIMEOUT_S
        int "Seconds to wait for an IP"
        default 30

    choice WDD_FRAMES_TRANSPORT
        prompt "Frame transport"
        default WDD_FRAMES_UDP
        help
            UDP 一帧切成分片发送，收到更新的帧号就丢弃未组装完的旧帧（低延迟、不排队）；
            TCP 是长度前缀的字节流，无丢帧但受往返/窗口限制（实测上限 114 fps，
            而设备内部 decode+flush 只要 5.7 ms）。

        config WDD_FRAMES_UDP
            bool "UDP fragments with stale-frame dropping"

        config WDD_FRAMES_TCP
            bool "TCP stream ([u32 length][JPEG])"
    endchoice

    config WDD_UDP_PORT
        int "UDP port for JPEG fragments"
        default 5002

    config WDD_TCP_PORT
        int "TCP port for the length-prefixed stream"
        default 5001

endmenu
```
